## AutoGartenhauschen/components/wifi/Kconfig
```kconfig
menu "Wifi configuration"
    config EXAMPLE_WIFI_SSID
        string "SSID of Network"
        default "Mi Phone"

    config EXAMPLE_WIFI_PASSWORD
        string "Password of Network"
        default "32001bf0cb35"
endmenu
```
